## config/boards/shields/Y52/Kconfig.shield
```kconfig
# Copyright (c) 2020 Ryan Cross
# SPDX-License-Identifier: MIT

config SHIELD_Y52_LEFT
	def_bool $(shields_list_contains,Y52_left)

config SHIELD_Y64_RIGHT
	def_bool $(shields_list_contains,Y52_right)
```

## config/boards/shields/Y94/boards/Kconfig.shield
```kconfig
# Copyright (c) 2020 Ryan Cross
# SPDX-License-Identifier: MIT

config SHIELD_Y94_LEFT
	def_bool $(shields_list_contains,Y94_left)

config SHIELD_Y64_RIGHT
	def_bool $(shields_list_contains,Y94_right)
```
