/*
 * Copyright (c) 2020 Ryan Cross
 *
 * SPDX-License-Identifier: MIT
 */

#include "Y94.dtsi"

&default_transform {
	col-offset = <10>;
};

&kscan0 {
	col-gpios
	  = <&pro_micro 20 (GPIO_ACTIVE_HIGH)> // COL0 
        , <&pro_micro 21 (GPIO_ACTIVE_HIGH)> // COL1 
        , <&pro_micro 9 (GPIO_ACTIVE_HIGH)> // COL2 
        , <&pro_micro 8 (GPIO_ACTIVE_HIGH)> // COL3 
	, <&pro_micro 7 (GPIO_ACTIVE_HIGH)> // COL1 
        , <&pro_micro 6 (GPIO_ACTIVE_HIGH)> // COL2 
        , <&pro_micro 5 (GPIO_ACTIVE_HIGH)> // COL3 
	, <&pro_micro 4 (GPIO_ACTIVE_HIGH)> // COL1 
        , <&pro_micro 3 (GPIO_ACTIVE_HIGH)> // COL2 
        , <&pro_micro 2 (GPIO_ACTIVE_HIGH)> // COL4 
};

&right_encoder {
	status = "okay";
};
