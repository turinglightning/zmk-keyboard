/*
 * Copyright (c) 2020 Ryan Cross
 *
 * SPDX-License-Identifier: MIT
 */

#include "Y64.dtsi"

&kscan0 {
	col-gpios
		= <&gpio1 6  GPIO_ACTIVE_HIGH>
		, <&gpio1 4  GPIO_ACTIVE_HIGH>
		, <&gpio0 11  GPIO_ACTIVE_HIGH>
		, <&gpio1 00 GPIO_ACTIVE_HIGH>
		, <&gpio0 24  GPIO_ACTIVE_HIGH>
		, <&gpio0 22 GPIO_ACTIVE_HIGH>
		, <&gpio0 20 GPIO_ACTIVE_HIGH>
		;
};

&left_encoder {
	status = "okay";
};
